## samples/openthread/coap_client/boards/nrf52_bsim.conf
```kconfig
CONFIG_DK_LIBRARY=n
CONFIG_FPU=n

CONFIG_NRF_802154_SOURCE_INTERNAL=y
CONFIG_NET_LOG=y
CONFIG_LOG=y
CONFIG_OPENTHREAD_DEBUG=y
CONFIG_OPENTHREAD_L2_DEBUG=y
CONFIG_OPENTHREAD_L2_LOG_LEVEL_INF=y
CONFIG_FLASH=n
```
