## CMakeLists.txt
```
# Copyright (c) 2023 Nordic Semiconductor ASA
# SPDX-License-Identifier: LicenseRef-Nordic-5-Clause

cmake_minimum_required(VERSION 3.20.0)

find_package(Zephyr REQUIRED HINTS $ENV{ZEPHYR_BASE})

project(test_openthread_coap_server)

set(sample_path ${NRF_DIR}/samples/openthread/coap_server/)

target_sources(app PRIVATE 
  ${sample_path}/src/coap_server.c
  ${sample_path}/src/ot_coap_utils.c
)

target_include_directories(app PUBLIC ${sample_path}/interface)

target_sources(app PRIVATE src/test_server.c
  ../coap_client/src/bsim_dk_buttons_and_leds.c
)

zephyr_include_directories(
  $ENV{BSIM_COMPONENTS_PATH}/libUtilv1/src/
)
```

## Kconfig
```
# Copyright (c) 2023 Nordic Semiconductor ASA
# SPDX-License-Identifier: LicenseRef-Nordic-5-Clause

source "$(ZEPHYR_NRF_MODULE_DIR)/samples/openthread/coap_server/Kconfig"
```

## prj.conf
```kconfig
# Copyright (c) 2023 Nordic Semiconductor
# SPDX-License-Identifier: LicenseRef-Nordic-5-Clause

# Enable OpenThread CoAP support API
CONFIG_OPENTHREAD_COAP=y

# Network sockets
CONFIG_NET_SOCKETS=y
CONFIG_NET_SOCKETS_POSIX_NAMES=y
CONFIG_NET_SOCKETS_POLL_MAX=4

# Same network Master Key for client and server
CONFIG_OPENTHREAD_NETWORKKEY="00:11:22:33:44:55:66:77:88:99:aa:bb:cc:dd:ee:ff"

# L2 OpenThread enabling
CONFIG_NET_L2_OPENTHREAD=y

# Generic networking options
CONFIG_NETWORKING=y

CONFIG_MBEDTLS_SHA1_C=n
CONFIG_FPU=n

CONFIG_DK_LIBRARY=n

CONFIG_NRF_802154_SOURCE_INTERNAL=y
CONFIG_NET_LOG=y
CONFIG_LOG=y
CONFIG_OPENTHREAD_DEBUG=y
CONFIG_OPENTHREAD_L2_DEBUG=y
CONFIG_OPENTHREAD_L2_LOG_LEVEL_INF=y
CONFIG_FLASH=n
```

## src/test_server.c
```c
/*
 * Copyright (c) 2023 Nordic Semiconductor ASA
 *
 * SPDX-License-Identifier: LicenseRef-Nordic-5-Clause
 */

#include "bstests.h"
#include <dk_buttons_and_leds.h>
#include <zephyr/kernel.h>

extern enum bst_result_t bst_result;

static void test_coap_server_init(void)
{
	/*
	 * We aren't really testing anything => we just claim we pass
	 * so it does not appear as a failed test
	 */
	bst_result = Passed;
}

void fake_button_press(int button);
void fake_button_release(int button);

K_THREAD_STACK_DEFINE(test_thread_stack, 256);
struct k_thread test_server_thread;

/**
 * A thread that injects a few "button presses"
 * as if an operator was driving the test
 */
static void test_thread_entry(void *a, void *b, void *c){
	ARG_UNUSED(a);
	ARG_UNUSED(b);
	ARG_UNUSED(c);

	k_sleep(K_SECONDS(30));
	/* Go into pairing mode */
	fake_button_press(3);
	k_sleep(K_MSEC(50));
	fake_button_release(3);
}

static void test_coap_server_post_kernel(void)
{
	k_thread_create(&test_server_thread, test_thread_stack,
			K_THREAD_STACK_SIZEOF(test_thread_stack),
			test_thread_entry,
			NULL, NULL, NULL,
			1, 0, K_NO_WAIT);
}

static const struct bst_test_instance test_coap_server[] = {
	{
		.test_id = "coap_server",
		.test_descr = "COAP server 'test'. It pretends to press"
			"a DK button after 30 seconds, to switch into pairing "
			"mode ",
		.test_post_init_f = test_coap_server_init,
		.test_fake_ddriver_postkernel_f = test_coap_server_post_kernel,
	},
	BSTEST_END_MARKER
};

struct bst_test_list *test_coap_server_install(struct bst_test_list *tests)
{
	tests = bst_add_tests(tests, test_coap_server);
	return tests;
}

bst_test_install_t test_installers[] = {
	test_coap_server_install,
	NULL
};
```
