## CMakeLists.txt
```
# Copyright (c) 2023 Nordic Semiconductor ASA
# SPDX-License-Identifier: LicenseRef-Nordic-5-Clause

cmake_minimum_required(VERSION 3.20.0)

find_package(Zephyr REQUIRED HINTS $ENV{ZEPHYR_BASE})

project(test_openthread_coap_client)

set(sample_path ${NRF_DIR}/samples/openthread/coap_client)

target_sources(app PRIVATE
  ${sample_path}/src/coap_client.c
  ${sample_path}/src/coap_client_utils.c
  ${sample_path}/src/ble_utils.c
)

target_include_directories(app PUBLIC ${sample_path}/../coap_server/interface)

target_sources(app PRIVATE src/bsim_test_client.c
  src/bsim_dk_buttons_and_leds.c
)

zephyr_include_directories(
  $ENV{BSIM_COMPONENTS_PATH}/libUtilv1/src/
)
```

## Kconfig
```
# Copyright (c) 2023 Nordic Semiconductor ASA
# SPDX-License-Identifier: LicenseRef-Nordic-5-Clause

source "$(ZEPHYR_NRF_MODULE_DIR)/samples/openthread/coap_client/Kconfig"
```

## prj.conf
```kconfig
# Copyright (c) 2023 Nordic Semiconductor
# SPDX-License-Identifier: LicenseRef-Nordic-5-Clause

CONFIG_DK_LIBRARY=n
# Enable CoAP utils and CoAP protocol
CONFIG_COAP=y
CONFIG_COAP_UTILS=y

# Generic networking options
CONFIG_NETWORKING=y

# L2 OpenThread enabling
CONFIG_NET_L2_OPENTHREAD=y


# Network sockets
CONFIG_NET_SOCKETS=y
CONFIG_NET_SOCKETS_POSIX_NAMES=y
CONFIG_NET_SOCKETS_POLL_MAX=4

# Same network Master Key for client and server
CONFIG_OPENTHREAD_NETWORKKEY="00:11:22:33:44:55:66:77:88:99:aa:bb:cc:dd:ee:ff"

CONFIG_MBEDTLS_SHA1_C=n
CONFIG_FPU=n

CONFIG_NRF_802154_SOURCE_INTERNAL=y
CONFIG_NET_LOG=y
CONFIG_LOG=y
CONFIG_OPENTHREAD_DEBUG=y
CONFIG_OPENTHREAD_L2_DEBUG=y
CONFIG_OPENTHREAD_L2_LOG_LEVEL_INF=y
CONFIG_FLASH=n
```

## src/bsim_dk_buttons_and_leds.c
```c
/*
 * Copyright (c) 2023 Nordic Semiconductor ASA
 *
 * SPDX-License-Identifier: LicenseRef-Nordic-5-Clause
 */

/** @file
 *  @brief Quick replacement for the DK buttons/LED interface for simulation
 */

// TODO: Consider modifying the DK library so instead of replacing it
//       we have test hooks on it
//       Consider adding callbacks to leds toggle?

#include <stdint.h>
#include "bs_types.h"
#include "bs_tracing.h"
#include "bs_utils.h"
#include <dk_buttons_and_leds.h>

#define N_LEDS 32
#define N_BUTTONS 32
static bool leds_status[N_LEDS];
static bool button_status[N_LEDS];
static uint32_t button_mask;
static char *on_string[2] = {"OFF", "ON"};
static button_handler_t button_handler_cb = NULL;

int dk_set_led(uint8_t led_idx, uint32_t val){
	val = BS_MIN(val,1);
	led_idx = BS_MIN(led_idx,N_LEDS-1);
	bs_trace_info_time(2, "LED %i %s->%s\n", led_idx,
			   on_string[leds_status[led_idx]],
			   on_string[val]);
	leds_status[led_idx] = val;
	return 0;
}

int dk_set_led_on(uint8_t led_idx)
{
	return dk_set_led(led_idx, true);
}

int dk_set_led_off(uint8_t led_idx)
{
	return dk_set_led(led_idx, false);
}

int dk_buttons_init(button_handler_t button_handler){
	button_handler_cb = button_handler;
	return 0;
}

int dk_leds_init(void){
	/* Purposefully left empty */
	return 0;
}

/**
 * Pretend to press a DK button (note <button> is indexed from 0)
 */
void fake_button_press(int button){
	button = BS_MIN(button, N_BUTTONS-1);
	uint32_t bit_mask = 1<<button;
	uint32_t change_mask = 0;

	if ((button_mask & bit_mask) == 0) {
		change_mask = bit_mask;
	}
	button_mask |= bit_mask;

	bs_trace_info_time(2, "Button %i pressed, was %s\n", button+1,
			   on_string[button_status[button]]);
	button_status[button] = true;

	if (button_handler_cb) {
		button_handler_cb(button_mask, change_mask);
	}
}

/**
 * Pretend to release a DK button (note <button> is indexed from 0)
 */
void fake_button_release(int button){
	button = BS_MIN(button, N_BUTTONS-1);
	uint32_t bit_mask = 1<<button;
	uint32_t change_mask = 0;

	if (button_mask & bit_mask) {
		change_mask = bit_mask;
	}
	button_mask &= ~bit_mask;

	bs_trace_info_time(2, "Button %i released, was %s\n", button+1,
			   on_string[button_status[button]]);
	button_status[button] = false;

	if (button_handler_cb) {
		button_handler_cb(button_mask, change_mask);
	}
}
```

## src/bsim_test_client.c
```c
/*
 * Copyright (c) 2023 Nordic Semiconductor ASA
 *
 * SPDX-License-Identifier: LicenseRef-Nordic-5-Clause
 */

#include "bstests.h"
#include <dk_buttons_and_leds.h>
#include <zephyr/kernel.h>

extern enum bst_result_t bst_result;

static void test_coap_client_init(void)
{
	/*
	 * We aren't really testing anything => we just claim we pass
	 * so it does not appear as a failed test
	 */
	bst_result = Passed;
}

K_THREAD_STACK_DEFINE(test_thread_stack, 256);
struct k_thread test_client_thread;

void fake_button_press(int button);
void fake_button_release(int button);

/**
 * A thread that injects a few "button presses"
 * as if an operator was driving the test
 */
static void test_thread_entry(void *a, void *b, void *c){
	ARG_UNUSED(a);
	ARG_UNUSED(b);
	ARG_UNUSED(c);

	k_sleep(K_SECONDS(10));
	/* Request a multicast light toggle */
	fake_button_press(1);
	k_sleep(K_MSEC(100));
	fake_button_release(1);

	k_sleep(K_SECONDS(20));
	/* Send a multicast pairing request */
	fake_button_press(3);
	k_sleep(K_MSEC(50));
	fake_button_release(3);

	k_sleep(K_SECONDS(5));
	/* Request a unicast light toggle */
	fake_button_press(0);
	k_sleep(K_MSEC(100));
	fake_button_release(0);
}

static void test_coap_client_post_kernel(void)
{
	k_thread_create(&test_client_thread, test_thread_stack,
			K_THREAD_STACK_SIZEOF(test_thread_stack),
			test_thread_entry,
			NULL, NULL, NULL,
			1, 0, K_NO_WAIT);
}

static const struct bst_test_instance test_coap_client[] = {
	{
		.test_id = "coap_client",
		.test_descr = "COAP client 'test'. It pretends to press"
			"a few DK buttons, to trigger light toggles and "
			"pairing request ",
		.test_post_init_f = test_coap_client_init,
		.test_fake_ddriver_postkernel_f = test_coap_client_post_kernel,
	},
	BSTEST_END_MARKER
};

struct bst_test_list *test_coap_client_install(struct bst_test_list *tests)
{
	tests = bst_add_tests(tests, test_coap_client);
	return tests;
}

bst_test_install_t test_installers[] = {
	test_coap_client_install,
	NULL
};
```
